/dts-v1/;
/plugin/;

/ {
	compatible = "brcm,bcm2835";

	fragment@0 {
		target = <&soc>;
		__overlay__ {
			periphmem {
				compatible = "brcm,bcm2835-periphmem";
				reg = <0x7e000000 0x01000000>;
			};
		};
	};
};
